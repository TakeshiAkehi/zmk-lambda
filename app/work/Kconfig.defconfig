## app/work/Kconfig.defconfig
```kconfig
if SHIELD_FISH_LEFT
config ZMK_KEYBOARD_NAME
    default "Fish Keyboard"
config ZMK_SPLIT_ROLE_CENTRAL
    default y
endif

if SHIELD_FISH_LEFT || SHIELD_FISH_RIGHT
config ZMK_SPLIT
    default y
endif
```

## config/boards/shields/template/Kconfig.defconfig
```kconfig
# Copyright (c) 2021 The ZMK Contributors
# SPDX-License-Identifier: MIT

# 親機にしたい方をコメントアウト
if SHIELD_$TEMPLATE$_LEFT
# if SHIELD_$TEMPLATE$_RIGHT

config ZMK_KEYBOARD_NAME
    default "Fish Keyboard"

config ZMK_SPLIT_ROLE_CENTRAL
    default y

endif


if SHIELD_$TEMPLATE$_LEFT || SHIELD_$TEMPLATE$_RIGHT

config ZMK_SPLIT
    default y

endif
```

## config/boards/shields/template/Kconfig.shield
```kconfig
# Copyright (c) 2021 The ZMK Contributors
# SPDX-License-Identifier: MIT

config SHIELD_$TEMPLATE$_LEFT
    def_bool $(shields_list_contains,$template$_left)

config SHIELD_$TEMPLATE$_RIGHT
    def_bool $(shields_list_contains,$template$_right)
```
